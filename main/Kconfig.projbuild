## main/Kconfig.projbuild
```kconfig
menu "Snoring Detector Configuration"

    config SNORING_WIFI_SSID
        string "WiFi SSID"
        default ""
        help
            SSID (network name) to connect to.

    config SNORING_WIFI_PASSWORD
        string "WiFi Password"
        default ""
        help
            WiFi password (WPA or WPA2).

    config SNORING_MQTT_BROKER_URI
        string "MQTT Broker URI"
        default "mqtt://127.0.0.1:1883"
        help
            MQTT broker URI.

endmenu
```

## sdkconfig.defaults
```kconfig
# C++ settings
CONFIG_COMPILER_CXX_EXCEPTIONS=y

# PSRAM Configuration
CONFIG_SPIRAM=y
CONFIG_SPIRAM_MODE_OCT=y
CONFIG_SPIRAM_SPEED_80M=y
CONFIG_SPIRAM_USE_CAPS_ALLOC=y
# CONFIG_SPIRAM_USE_MALLOC is not set

# Dual core mode
# CONFIG_FREERTOS_UNICORE is not set

# Custom partition table
CONFIG_PARTITION_TABLE_CUSTOM=y
CONFIG_PARTITION_TABLE_CUSTOM_FILENAME="partitions.csv"
CONFIG_PARTITION_TABLE_FILENAME="partitions.csv"
```
